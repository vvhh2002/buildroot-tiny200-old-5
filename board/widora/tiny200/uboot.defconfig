## board/widora/tiny200/uboot.defconfig
```kconfig
CONFIG_ARM=y
CONFIG_ARCH_SUNXI=y
CONFIG_MACH_SUNIV=y
CONFIG_DEFAULT_DEVICE_TREE="suniv-f1c100s-generic"

CONFIG_SYS_CLK_FREQ=408000000
CONFIG_DRAM_CLK=168
CONFIG_DRAM_ZQ=0

CONFIG_CONS_INDEX=2

CONFIG_SPL=y
CONFIG_SPL_SPI_SUNXI=y
CONFIG_MMC_SUNXI_SLOT_EXTRA=1

CONFIG_SYS_TEXT_BASE=0x81700000

CONFIG_ENV_IS_NOWHERE=y
CONFIG_ENV_IS_IN_FAT=n
CONFIG_USE_DEFAULT_ENV_FILE=y
CONFIG_DEFAULT_ENV_FILE="../../../board/widora/tiny200/uboot.env"

CONFIG_BOOTDELAY=0

CONFIG_VIDEO_LCD_MODE="x:480,y:272,depth:18,pclk_khz:10000,le:42,ri:8,up:11,lo:4,hs:1,vs:1,sync:3,vmode:0"
CONFIG_VIDEO_LCD_BL_PWM="PE6"
CONFIG_VIDEO_LCD_BL_PWM_ACTIVE_LOW=n

CONFIG_NET=n

CONFIG_PHY=y
CONFIG_PHY_SUN4I_USB=y

CONFIG_USB_MUSB_SUNXI=y
CONFIG_USB_MUSB_GADGET=y
CONFIG_USB_MUSB_PIO_ONLY=y
CONFIG_USB_MUSB_DISABLE_BULK_COMBINE_SPLIT=y
CONFIG_USB_GADGET_VBUS_DRAW=250

CONFIG_USB_STORAGE=y
CONFIG_CMD_USB_MASS_STORAGE=y

CONFIG_SPI=y
CONFIG_DM_SPI=y
CONFIG_SPI_SUNXI=y

CONFIG_MTD=y
CONFIG_DM_MTD=y
CONFIG_CMD_MTD=y
CONFIG_MTD_SPI_NAND=y

CONFIG_SPI_FLASH=y
CONFIG_DM_SPI_FLASH=y
CONFIG_SPI_FLASH_BAR=y
CONFIG_SPI_FLASH_WINBOND=y
```
